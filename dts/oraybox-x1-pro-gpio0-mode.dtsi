/* Add this child to the existing /keys node in mt7628an_oraybox_x1.dts. */
mode {
	label = "mode";
	linux,code = <BTN_0>;
	linux,input-type = <EV_SW>;
	gpios = <&pio 0 GPIO_ACTIVE_LOW>;
	debounce-interval = <60>;
};
